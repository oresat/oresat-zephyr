## apps/solar/sample.yaml
```yaml
sample:
  name: oresat-solar
common:
  tags:
    - can
    - canopen
  modules:
    - canopennode
  integration_platforms:
    - nucleo_f091rc
```

## boards/oresat_protocard/Kconfig.oresat_protocard
```kconfig
# Copyright (c) 2017 Bobby Noelte
# SPDX-License-Identifier: Apache-2.0

config BOARD_ORESAT_PROTOCARD
	select SOC_STM32F091XC
```
