## CMakeLists.txt
```
cmake_minimum_required(VERSION 3.20.0)

find_package(Zephyr REQUIRED HINTS $ENV{ZEPHYR_BASE})

project("oresat-battery" LANGUAGES C)

execute_process(COMMAND bash -c "oresat-configs canopennode od.yaml ../../common/od.yaml -d gen")

target_sources(app PRIVATE
  src/main.c
  gen/OD.c
)

zephyr_include_directories(gen)
```

## sample.yaml
```
sample:
  name: oresat-battery
common:
  tags:
    - can
    - canopen
  modules:
    - canopennode
  integration_platforms:
    - nucleo_f091rc
```

## prj.conf
```kconfig
CONFIG_GPIO=y
CONFIG_SENSOR=y
CONFIG_CAN=y
CONFIG_CAN_DEFAULT_BITRATE=1000000
CONFIG_CANOPENNODE_V4=y
CONFIG_CANOPENNODE_THREADS=y
CONFIG_REBOOT=y
CONFIG_STM32_VREF=y
CONFIG_STM32_TEMP=y
```

## src/main.c
```c
#include <zephyr/kernel.h>
#include <zephyr/device.h>
#include <zephyr/sys/reboot.h>
#include <canopennode.h>
#include <OD.h>
#include "board_sensors.h"
#include "oresat.h"

#define CAN_INTERFACE DEVICE_DT_GET(DT_CHOSEN(zephyr_canbus))
#define CAN_BITRATE (DT_PROP_OR(DT_CHOSEN(zephyr_canbus), bitrate, \
					  DT_PROP_OR(DT_CHOSEN(zephyr_canbus), bus_speed, \
						     CONFIG_CAN_DEFAULT_BITRATE)) / 1000)

int main(void) {
	k_timepoint_t timepoint;
	uint8_t node_id = get_node_id();

	canopennode_init(CAN_INTERFACE, CAN_BITRATE, node_id);
	board_sensors_init();

	while (canopennode_is_running()) {
		timepoint = sys_timepoint_calc(K_MSEC(1000));
		board_sensors_fill_od();
		k_sleep(sys_timepoint_timeout(timepoint));
	}

	canopennode_stop(CAN_INTERFACE);
	sys_reboot(SYS_REBOOT_COLD);

	return 0;
}
```
