## boards/diode_test/Kconfig.diode_test
```kconfig
# Copyright (c) 2017 Bobby Noelte
# SPDX-License-Identifier: Apache-2.0

config BOARD_DIODE_TEST
	select SOC_STM32F091XC
```

## boards/oresat/reaction_wheel/Kconfig.defconfig
```kconfig
if BOARD_REACTION_WHEEL

config SPI_STM32_INTERRUPT
	default y
	depends on SPI

endif # BOARD_REACTION_WHEEL
```

## boards/oresat/reaction_wheel/board.yml
```yaml
board:
  name: reaction_wheel
  vendor: st
  revision:
    format: major.minor.patch
    default: 7.2.0
    exact: true
    revisions:
      - name: 7.1.0
      - name: 7.2.0
  socs:
    - name: stm32g474xx
```

## west.yml
```yaml
manifest:
  remotes:
    - name: zephyrproject-rtos
      url-base: https://github.com/zephyrproject-rtos
  projects:
    - name: zephyr
      remote: zephyrproject-rtos
      revision: b6aed5c
      import:
        name-allowlist:
          - cmsis
          - hal_stm32
          - mcuboot
          - mbedtls
          - canopennode
    - name: CANopenNode
      url: https://github.com/CANopenNode/CANopenNode
      revision: 58012aa
      path: oresat-zephyr/common/canopennode_v4/CANopenNode
    - name: oresat-configs
      url: https://github.com/oresat/oresat-configs
```
